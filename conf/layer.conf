## conf/layer.conf
```bitbake
# We have a conf and classes directory, add to BBPATH
BBPATH .= ":${LAYERDIR}"

# We have a packages directory, add to BBFILES
BBFILES += "${LAYERDIR}/recipes-*/*/*.bb \
            ${LAYERDIR}/recipes-*/*/*.bbappend"

BBFILE_COLLECTIONS += "micropross"
BBFILE_PATTERN_micropross := "^${LAYERDIR}/"
BBFILE_PRIORITY_micropross = "5"
LAYERSERIES_COMPAT_micropross = "thud"
LAYERDEPENDS_micropross = "core freescale-layer"
```

## conf/machine/imx6qdl-mp500.conf
```bitbake
#@TYPE: Machine
#@NAME: Micropross MSC Q7 based machine
#@SOC: i.MX6QP/Q
#@DESCRIPTION: Machine configuration for Micropross MSC Q7 based machine

MACHINEOVERRIDES =. "mx6:mx6q:"

require conf/machine/include/imx-base.inc
require conf/machine/include/tune-cortexa9.inc

PREFERRED_PROVIDER_virtual/kernel = "linux-micropross"
KERNEL_DEVICETREE = "imx6q-mp500.dtb"
KERNEL_CONFIG_COMMAND = "oe_runmake -C ${S} CC="${KERNEL_CC}" O=${B} imx6_mp500_defconfig"

PREFERRED_PROVIDER_u-boot = "u-boot-micropross"
PREFERRED_PROVIDER_virtual/bootloader = "u-boot-micropross"
UBOOT_MACHINE ?= "q7-imx6_defconfig"
UBOOT_MAKE_TARGET = "all"
UBOOT_SUFFIX = "bin"

SERIAL_CONSOLES = "57600;ttymxc1"

WKS_FILE = "mp500.wks"

MACHINE_FEATURES += " pci"
```

## meta-brewery/conf/distro/Brewery.conf
```bitbake
DISTRO = "Brewery"
DISTRO_VERSION = "2022.02"
DISTRO_NAME = "Brewery (Micropross Reference Distribution)"
DISTRO_CODENAME = "Filou"

PACKAGECONFIG_pn-systemd_append = " networkd timedated timesyncd logind resolved hostnamed"

PACKAGE_CLASSES ?= "package_ipk"

USER_CLASSES ?= "buildstats image-mklibs image-buildinfo"

DISTRO_FEATURES_append = " systemd pci usbgadget usbhost"
DISTRO_FEATURES_BACKFILL_CONSIDERED = "sysvinit"

VIRTUAL-RUNTIME_init_manager = "systemd"

EXTRA_IMAGEDEPENDS += "u-boot"
```

## meta-brewery/conf/layer.conf
```bitbake
# We have a conf and classes directory, add to BBPATH
BBPATH .= ":${LAYERDIR}"

# We have recipes-* directories, add to BBFILES
BBFILES += "${LAYERDIR}/recipes-*/*/*.bb \
            ${LAYERDIR}/recipes-*/*/*.bbappend"

BBFILE_COLLECTIONS += "meta-brewery"
BBFILE_PATTERN_meta-brewery = "^${LAYERDIR}/"
BBFILE_PRIORITY_meta-brewery = "6"

LAYERDEPENDS_meta-brewery = "core"
LAYERSERIES_COMPAT_meta-brewery = "dunfell"
```

## meta-micropross-core/conf/layer.conf
```bitbake
# We have a conf and classes directory, add to BBPATH
BBPATH .= ":${LAYERDIR}"

# We have recipes-* directories, add to BBFILES
BBFILES += "${LAYERDIR}/recipes-*/*/*.bb \
            ${LAYERDIR}/recipes-*/*/*.bbappend"

BBFILE_COLLECTIONS += "meta-micropross-core"
BBFILE_PATTERN_meta-micropross-core = "^${LAYERDIR}/"
BBFILE_PRIORITY_meta-micropross-core = "6"

LAYERDEPENDS_meta-micropross-core = "core"
LAYERSERIES_COMPAT_meta-micropross-core = "warrior thud sumo"
```

## meta-txgrl/conf/layer.conf
```bitbake
# We have a conf and classes directory, add to BBPATH
BBPATH .= ":${LAYERDIR}"

# We have recipes-* directories, add to BBFILES
BBFILES += "${LAYERDIR}/recipes-*/*/*.bb \
            ${LAYERDIR}/recipes-*/*/*.bbappend"

BBFILE_COLLECTIONS += "meta-txgrl"
BBFILE_PATTERN_meta-txgrl = "^${LAYERDIR}/"
BBFILE_PRIORITY_meta-txgrl = "6"

LAYERDEPENDS_meta-txgrl = "core"
LAYERSERIES_COMPAT_meta-txgrl = "dunfell"
```

## meta-txgrl/conf/machine/ni-txgrl.conf
```bitbake
require conf/machine/ni-zynq.inc

MACHINEOVERRIDES = "ni-txgrl:${MACHINE}"

MACHINE_FEATURES = "vfat ethernet usbhost ext2 rtc"

SERIAL_CONSOLES ?= "115200;ttyPS0"
SERIAL_CONSOLES_CHECK = "${SERIAL_CONSOLES}"

UBOOT_MACHINE_ni-txgrl = "ni_txgrl_defconfig"
UBOOT_SUFFIX_ni-txgrl = "img"
UBOOT_ENTRYPOINT_ni-txgrl = "0000000"
UBOOT_LOADADDRESS_ni-txgrl = "0000000"
UBOOT_BINARY_ni-txgrl = "u-boot.${UBOOT_SUFFIX}"
SPL_BINARY_ni-txgrl = "spl/boot.bin"


IMAGE_BOOT_FILES ?= "boot.bin ${UBOOT_BINARY}"

KERNEL_CLASSES += "kernel-fitimage"
KERNEL_IMAGETYPE = "fitImage"
KERNEL_DEFCONFIG ?= "ni_txgrl_defconfig"

PREFERRED_VERSION_u-boot = "2020.01"
PREFERRED_VERSION_linux-yocto = "5.4.%"

MACHINE_EXTRA_RRECOMMENDS = " \
                             kernel-modules \
                             kernel-image \
                             kernel-module-ni_cts3_spy \
                             kernel-module-ni_cts3_daq \
                            "

IMAGE_INSTALL_append_ni-txgrl = " \
                                 kernel-image \
                                 txgrl-bsp \
                                "

KERNEL_DEVICETREE_ni-txgrl = " \
                                  zynq-ni-txgrl-revb.dtb \
                                  zynq-ni-txgrl-reva.dtb \
                                 "
```
