/dts-v1/;
/plugin/;

/ {
    fragment@0 {

        target = <&spi0>;
        __overlay__ {
            flash: n25q512a@0 {
                #address-cells = <1>;
                #size-cells = <1>;
                compatible = "micron,n25q512ax3", "jedec,spi-nor";
                reg = <0>;
                spi-max-frequency = <10000000>;
                m25p,fast-read;
            };
        };
    };
};
