/dts-v1/;
/plugin/;

/ {
    fragment@0 {
        target = <&fpga_full>;
        #address-cells = <1>;
        #size-cells = <1>;

        __overlay__ {
            #address-cells = <1>;
            #size-cells = <1>;

            firmware-name = "top.bin";
        };
    };

};
