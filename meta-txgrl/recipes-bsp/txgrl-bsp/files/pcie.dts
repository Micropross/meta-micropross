/dts-v1/;
/plugin/;

/ {
    fragment@0 {

        target = <&amba>;
        __overlay__ {

            pci_express: axi-pcie@80000000 {
                #address-cells = <3>;
                #size-cells = <2>;
                #interrupt-cells = <1>;
                compatible = "xlnx,axi-pcie-host-1.00.a";
                reg = < 0x80000000 0x4000000 >;
                device_type = "pci";
                interrupt-parent = <&intc>;
                interrupts = < 0 36 4 >;
                interrupt-map-mask = <0 0 0 7>;
                interrupt-map = <0 0 0 1 &pcie_intc 1>,
                        <0 0 0 2 &pcie_intc 2>,
                        <0 0 0 3 &pcie_intc 3>,
                        <0 0 0 4 &pcie_intc 4>;
                ranges = < 0x02000000 0 0x90000000 0x90000000 0 0x20000000 >;

                pcie_intc: interrupt-controller {
                    interrupt-controller;
                    #address-cells = <0>;
                    #interrupt-cells = <1>;
                };
            };
        };
    };
};
